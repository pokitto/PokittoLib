/****** FLAPPY BIRDO ***** clone of Dong Nguyen's Flappy Bird.
- coded by Jerom (2015) + help from Skyrunner65, clement.
- SFX with the help of FX Synth by yodasvideoarcade http://gamebuino.com/forum/viewtopic.php?f=17&t=1018
*/

#include <SPI.h> //imports the SPI library (needed to communicate with Gamebuino's screen)
#include <Gamebuino.h> //imports the Gamebuino library
Gamebuino gb; //creates a Gamebuino object named gb

//IMAGES
const byte bird1Bitmap[] PROGMEM = {16, 10, 0xF, 0x0, 0x3C, 0x80, 0x79, 0x40, 0xF8, 0x40, 0xFD, 0xC0, 0xC6, 0x20, 0x8D, 0xC0, 0x9E, 0x20, 0x7F, 0xC0, 0x1E, 0x0,};
const byte bird1MaskBitmap[] PROGMEM = {16, 10, 0xF, 0x0, 0x3F, 0x80, 0x7F, 0xC0, 0xFF, 0xC0, 0xFF, 0xC0, 0xFF, 0xE0, 0xFF, 0xC0, 0xFF, 0xE0, 0x7F, 0xC0, 0x1E, 0x0,};
const byte bird2Bitmap[] PROGMEM = {16, 10, 0xF, 0x0, 0x7C, 0x80, 0x99, 0x40, 0x88, 0x40, 0x8D, 0xC0, 0xC6, 0x20, 0xFD, 0xC0, 0xFE, 0x20, 0x7F, 0xC0, 0x1E, 0x0,};
const byte bird2MaskBitmap[] PROGMEM = {16, 10, 0xF, 0x0, 0x7F, 0x80, 0xFF, 0xC0, 0xFF, 0xC0, 0xFF, 0xC0, 0xFF, 0xE0, 0xFF, 0xC0, 0xFF, 0xE0, 0x7F, 0xC0, 0x1E, 0x0,};
const byte cityBitmap[] PROGMEM = {16, 19, 0x7E, 0x0, 0x42, 0x0, 0x56, 0x3F, 0x42, 0x21, 0x57, 0xAB, 0xC8,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 0x0,};
const byte gameoverBitmap[] PROGMEM = {32, 25, 0x0, 0x0, 0x0, 0x0, 0x0, 0x0, 0x0, 0x0, 0xF, 0x80, 0x0,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 0x0,};
const byte gameoverMaskBitmap[] PROGMEM = {32, 25, 0x1F, 0xC0, 0x0, 0x0, 0x3F, 0xE0, 0x0, 0xF8, 0x7F, 0xE0, 0x1,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 0xF0,};
const byte pipeBitmap[] PROGMEM = {16, 24, 0xFF, 0xF0, 0x80, 0x10, 0x83, 0xF0, 0xC5, 0xD0, 0xFF, 0xF0, 0xCF,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 0xF0,};
const byte skyBitmap[] PROGMEM = {24, 6, 0x1C, 0x0, 0x0, 0xA2, 0x7, 0xA0, 0x41, 0x8, 0x40, 0x43, 0xD0, 0x40, 0x4, 0x30, 0x0, 0x0, 0x10, 0x0,};
const byte skyMaskBitmap[] PROGMEM = {24, 6, 0x1C, 0x0, 0x0, 0xBE, 0x7, 0xA0, 0xFF, 0xF, 0xE0, 0xFF, 0xDF, 0xE0, 0xFF, 0xFF, 0xE0, 0xFF, 0xFF, 0xE0,};
const byte titleBitmap[] PROGMEM = {64, 30, 0x0, 0xF, 0xFC, 0x0, 0x0, 0x0, 0x0, 0x0, 0x0, 0x10, 0x44,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 0x0,};
const byte trophyBitmap[] PROGMEM = {24, 32, 0x0, 0x0, 0x0, 0x3F, 0xFF, 0xF0, 0x20, 0x0, 0x10, 0x3F, 0xFF,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 0x0,};
const byte trophyMaskBitmap[] PROGMEM = {24, 32, 0x7F, 0xFF, 0xF8, 0x7F, 0xFF, 0xF8, 0x7F, 0xFF, 0xF8, 0x7F, 0xFF,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 0xFC,};

//SOUND PATTERNS made with FX Synth
const byte soundfx[5][8] = {
  {0, 0, 61, 1, 0, 0, 2, 3}, // sound 0  = fly.
  {0, 6, 107, 1, 5, 4, 3, 8}, // sound 1 = +1 point.
  {0, 24, 55, 1, 0, 0, 5, 7}, // sound 2 = death.
  {0, 57, 2, 1, 7, 19, 5, 57}, // sound 3 = melody played when maximum score is reached.
  {0, 4, 37, 4, 7, 12, 3, 1}, // sound 4 = menu bip.
};

//ARRAY to store...
typedef struct {
  float x, y, //... X & Y positions of each pipes displayed on the screen.
        hs; //... 3 difficulty highscores.
} Pipe;
Pipe pipe[4]; //maximum size of the array.

//FONTS
extern const byte font3x5[];
extern const byte font5x7[];
//CONSTANTS
#define PIPEW 12 //pipe width.
#define PIPEH 24 //pipe height. //24
#define PIPEGAPV 24 //constant vertical gap between 2 pipes.
#define PIPEGAPH 30 //constant horizontal gap between 2 pipes.
#define GROUNDH 4 //height of the ground.
#define SCOREMAX 99 //99 points is the constant maximum score.
#define GAMEOVERX floor((LCDWIDTH - 30) / 2) //constant X position of the gameover sprite.
#define TROPHYX floor((LCDWIDTH - 22) / 2) //constant X position of the trophy sprite.
#define PLAYERX 12 //constant player X position.
#define PLAYERW 11 //constant player width.
#define PLAYERH 10 //constant player height.
// VARIABLES
float player_y = 0; //the player starts at the middle of the LCD screen height minus the ground height.
float gravity = 0; //gravity variable.
long difficulty_level = 0; //easy=0.5 < normal=1.0 < hard=2.0

bool player_death = false;//false=player alive. true=player dead.
byte player_animation = 0; //animation timer.
byte score = 0; // current score : each time the player pass tubes, the score increases of 1 point.
byte score_timer = 0; //each time a pipe passed the player X position, 1 point is added to the score.
bool score_units = false; //if the score is lower than 10, score_units equals 0, else score_units equals 1.
byte score_maxreached = 0; //used as a timer too when the SCOREMAX is reached.
byte highscore_1 = 0; //highscore
byte highscore_2 = 0;
byte highscore_3 = 0;
byte gameover_y = 0; //Y position of the gameover sprite.
byte gameover_timer = 0; //game over timer.
bool difficulty_menu = true;
bool sound_volume = true;

//SETUP
void setup() {
  gb.begin();
  initGame();
}

void initGame() {
  gb.titleScreen(F(""), titleBitmap); //
  gb.titleScreen(F("FLAPPY BIRD clone\n\nHOW TO PLAY\n.ARROWS/A to fly\n.B to mute\n.C to reset")); //Sub-menu with keys infos.
  initVariables(); //reset all variables.
  difficulty_menu = true; //will display the menu.
  difficulty_level = 1; //reset to NORMAL.
  sound_volume = true; //reset to 1.
}

void initVariables() {
  gb.pickRandomSeed(); //randomize an original random every restart.
  pipesStart(); //each pipes starts at a random height.
  //gb.changeGame(); //Really reset the game without pressing "C" two times...
  //gb.battery.show = false;
  //reset variables.
  player_y = ((LCDHEIGHT - GROUNDH) / 2) - 8; //the player starts at the middle of the LCD screen height minus the ground height.
  gravity = 0; //gravity variable.
  player_death = false;
  player_animation = 0;
  updateHighscore();
  score = 0;
  score_timer = - PLAYERX - (PLAYERW / 2);
  score_units = false;
  score_maxreached = 0;
  gameover_timer = 0;
  gameover_y = LCDHEIGHT;
}

//LOOP
void loop() {
  if (gb.update()) {
    if (difficulty_menu == true) {
      initDifficulty();
    } //end of difficulty menu.
    else {
      resetGame();
      soundMute();
      //ALWYAYS DRAW
      drawBackground();
      drawPipes();
      drawGround();
      drawScore();
      //Player actions
      if (player_death == false) {
        if (score < SCOREMAX) {
          playerMove();
          updatePipes();
        }
        else {
          gameWin();
        }
        drawPlayerAlive();
      }
      else { //when the player is dead...
        drawPlayerEnd();
        gameOver();
      }
    }//end of normal game.
  } //end of update().
} // end of loop().
