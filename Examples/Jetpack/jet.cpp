#include "Pokitto.h"
#include <math.h>
#include <vector>

Pokitto::Core game;

#include <stdint.h>
#define HEIGHT game.display.height
#define WIDTH game.display.width
#define T_WIDTH 12
#define T_HEIGHT 12
#define M_WIDTH 20
#define M_HEIGHT 14

const uint8_t cover[] = {
220,176,
255,255,255,255,255,255,255,255,255,255,255,255,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255,
255,255,255,255,255,255,255,255,255,255,255,255,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255,
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255,255,255,255,255,255,255,255,255,255,255,255,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255,

};
const uint8_t test[2][2+12*3] = {
{
12,12,
0,85,0,0,80,64,0,64,64,0,64,64,
1,85,0,4,85,0,4,85,84,4,85,80,
5,85,0,0,85,0,0,65,0,0,65,0,

},
{
12,12,
0,85,0,1,5,0,1,1,0,1,1,0,
0,85,64,0,85,16,21,85,16,5,85,16,
0,85,80,0,85,0,0,65,0,0,65,0,
}
};

const uint8_t tile[] = {
12,12,
63,63,63,12,12,12,48,48,48,207,207,207,
3,3,3,12,12,12,243,243,243,192,192,192,
3,3,3,252,252,252,48,48,48,192,192,192,

};

int tmap[M_HEIGHT][M_WIDTH] {
    {0,0,0,0,0,0,0,0,0,0,0,0,0,0,0,0,0,0,0,0},
    {0,0,0,0,0,0,0,0,0,0,0,0,0,0,0,0,0,0,0,0},
    {0,0,0,0,0,0,0,0,0,0,0,0,0,0,0,0,0,0,0,0},
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    {1,1,1,1,1,1,1,1,1,1,1,1,1,1,1,1,1,1,1,1}
};

int mget(int x,int y){
    return tmap[y][x];
}

void dmap(){
    /*
    for (int i=0;i<30*5;i++){
        if (tmap[i]==1) {
            game.display.print((i/30)*8);
            game.display.drawBitmap(8*(i%30),i/30*8,tile);
        }
    }
    */
    for (int y=0;y<M_HEIGHT;y++){
        for (int x=0;x<M_WIDTH;x++){
            if (tmap[y][x]==1){
                game.display.drawBitmap(x*T_WIDTH,y*T_HEIGHT,tile,0,0);
            }
        }
    }
}



using std::vector;

struct Particle {
    int x=random(WIDTH),y=random(HEIGHT);
    int vx=0,vy=0;
    int t=0;
    int color=3;
    float shrink=.2;
    float scale=2;
    Particle(int,int,int,float);
    void update(){
        t+=1;
        x+=vx;
        y+=vy;
        x+=random(-1,1);
        y+=random(-1,1);

        if (shrink) {
            scale-=.2;
        }

        game.display.color=color;
        game.display.fillCircle(x,y,scale);
    }
    //Circle(double r) : radius(r) { }
};

Particle::Particle(int px,int py,int thecolor, float thescale) {x=px; y=py; color=thecolor; scale=thescale;}

vector<Particle> parts;

struct Bullet{
    int x,y,vx;
    Bullet(int, int, int);
    void update(){
        x=x+vx;
        game.display.color=1+game.frameCount/3%3;
        game.display.fillCircle(x,y,2);
    }
};

Bullet::Bullet(int px, int py, int velocity) {x=px; y=py; vx=velocity;}

vector<Bullet> bullets;

struct Player{
    float x=110,y=88;
    float vx=0;
    float vy=0;
    int flip=0;
    int b_dir=1;
    int health=50;
    void update(){
        if (game.buttons.leftBtn()){
            vx=-2;
            flip=1;
            b_dir=-1;
        }
        else if (game.buttons.rightBtn()){
            vx=2;
            flip=0;
            b_dir=1;
        }
        else {vx=0;}

        if (mget((x+6)/T_WIDTH,(y+12+vy)/T_HEIGHT)==1){
            vy=0;
        }
        else{
            vy=2;
        }

        if (game.buttons.aBtn()){
            vy=-2;
            parts.push_back(Particle{x+2+(flip*10-flip*2),y+8,3,2});
        }

        if (game.buttons.pressed(5)){
            bullets.push_back(Bullet{x,y+6,8*b_dir});
        }

        x+=vx;
        y+=vy;
        game.display.color=0;
        game.display.drawBitmap(x,y,test[flip]);
    }
}player;


struct Comet{
    int x=random(220);
    int y=0;
    void update(){

        parts.push_back(Particle{x,y,2,3});
        x+=random(-3,3);

        y+=4;
        if (y>100){
        }

        if (x<=player.x+12 && x+12>=player.x && y<=player.y+12 && y+12>=player.y) {
            player.health-=1;
        }

        game.display.color=2;
        game.display.fillCircle(x,y,4+sin(game.frameCount));
    }
};

vector<Comet> comets;

void doParts(){
    for (int i=0;i<parts.size();i++){
        parts[i].update();
        if (parts[i].t>=20) {
            parts.erase(parts.begin()+i);
        }
    }
}
int main () {
game.begin();
comets.push_back(Comet());
game.display.loadRGBPalette(paletteCGA);
int state=0;
int score=0;
while (game.isRunning()) {

    if (game.update()) {

        //MENU STATE
        if (state==0){
            game.display.color=3;
            game.display.fillCircle(WIDTH/2,HEIGHT/2,60);
            game.display.color=0;
            game.display.fillCircle(WIDTH/2-8,HEIGHT/2-8,52);
            game.display.setInvisibleColor(3);
            game.display.drawBitmap(0,0,cover);

            if (game.buttons.aBtn()){
                state=1;
            }
        }

        //INGAME STATE
        else if (state==1){

        game.display.color=0;
        game.display.setInvisibleColor(0);
        dmap();
        //doParts();
        player.update();
        if (player.health<=0){
            state=2;
        }

        if (game.frameCount%4==0){
            comets.push_back(Comet());
        }

        for (int i=0;i<parts.size();i++){
            parts[i].update();
            if (parts[i].t>=20 || parts[i].scale<=0) {
                parts.erase(parts.begin()+i);
            }
        }

        for (int i=0;i<bullets.size();i++){
            bullets[i].update();
            if (bullets[i].x>220 || bullets[i].x<0){
                bullets.erase(bullets.begin()+i);
            }
        }

        for (int i=0;i<comets.size();i++){
            comets[i].update();
            if (mget(comets[i].x/T_WIDTH,comets[i].y/T_HEIGHT)==1){
                comets.erase(comets.begin()+i);
            }
        }

        game.display.color=1;
        game.display.setCursor(0,0);
        game.display.print(player.health);
        game.display.setCursor(0,8);
        game.display.print(score);
        }
        }

        //GAMEOVER STATE
        else if (state==2){

        }
}

return 1;
}
