#include "Pokitto.h" // include Pokitto library
//#include "SDFileSystem.h"

const unsigned int sfx_3_jump_length = 1329;
const unsigned char sfx_3_jump[] = {
117,98,99,120,145,131,124,114,105,96,87,79,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127
};

int main () {
    using namespace Pokitto;
    Core::begin();
    Sound::ampEnable(true);
    //Sound::playMusicStream("abbaye/music/0_PrayerofHopeN.raw", 0);
    while (Core::isRunning()) {
        if (Core::update()) {
            if(Buttons::cBtn()){
                Sound::playSFX(sfx_3_jump, sfx_3_jump_length);
                Display::bgcolor++;
            }
            if(Buttons::aBtn()){
                Display::print(1,1,"A");
            }
            if(Buttons::bBtn()){
                Sound::playSFX(sfx_3_jump, sfx_3_jump_length);
                Display::print(1,1,"B");
            }
            //Display::clear();
        }
    }
    return 0;
}